## main/Kconfig.projbuild
```kconfig
menu "Arrosage Firmware Configuration"

    config ARROSAGE_DEVICE_ID
        string "Device ID (utilise dans les topics MQTT arrosage/<device_id>/...)"
        default "arrosage-01"
        help
            Identifiant fixe du device, choisi au moment du flashage. Doit
            etre unique par device deploye (sert aussi de client_id MQTT).

    config ARROSAGE_WIFI_SSID
        string "SSID WiFi"
        default "myssid"

    config ARROSAGE_WIFI_PASSWORD
        string "Mot de passe WiFi"
        default "mypassword"

    config ARROSAGE_WIFI_STATIC_IP
        string "Adresse IP fixe du device"
        default "192.168.1.50"
        help
            Le device n'utilise pas le DHCP : cette IP est appliquee au
            demarrage. Permet au backend/dashboard de joindre le device de
            facon previsible (ex. pour l'OTA, voir CONFIG_ARROSAGE_ENABLE_OTA)
            sans dependre de ce que le routeur attribuerait dynamiquement.
            A choisir en dehors de la plage DHCP du routeur pour eviter tout
            conflit avec une autre adresse deja distribuee.

    config ARROSAGE_WIFI_STATIC_NETMASK
        string "Masque de sous-reseau"
        default "255.255.255.0"

    config ARROSAGE_WIFI_STATIC_GATEWAY
        string "Passerelle (IP du routeur)"
        default "192.168.1.1"

    config ARROSAGE_WIFI_STATIC_DNS
        string "Serveur DNS"
        default "192.168.1.1"
        help
            Necessaire pour resoudre le serveur NTP (ARROSAGE_NTP_SERVER,
            un nom d'hote) puisque le DHCP n'est plus utilise pour fournir un
            DNS automatiquement. La plupart des routeurs domestiques font
            aussi office de resolveur DNS : leur IP (= la passerelle,
            generalement) convient dans la majorite des cas.

    config ARROSAGE_MQTT_BROKER_URI
        string "URI du broker MQTT (ex: mqtt://192.168.1.10:1883)"
        default "mqtt://192.168.1.10:1883"
        help
            Broker Mosquitto local, sans TLS, acces anonyme.

    config ARROSAGE_NTP_SERVER
        string "Serveur NTP"
        default "pool.ntp.org"

    config ARROSAGE_TANK_HEIGHT_CM
        int "Hauteur totale de la cuve (cm), du capteur ultrason au fond"
        default 100
        help
            Utilisee pour convertir la distance mesuree par le capteur
            ultrason en niveau d'eau (water_level_cm = hauteur - distance).
            A calibrer selon le montage physique reel de chaque installation.

    config ARROSAGE_ENABLE_DIAG_CONSOLE
        bool "Activer la console de diagnostic (REPL UART) au demarrage"
        default n
        help
            A activer uniquement pour le bring-up materiel (voir
            docs/bring_up_checklist.md) : remplace le mode normal (tasks
            command/sensor) par une console interactive de test.

    menu "Broches (GPIO / ADC)"

        config ARROSAGE_VALVE1_GPIO
            int "GPIO vanne 1 (relais)"
            default 25

        config ARROSAGE_VALVE2_GPIO
            int "GPIO vanne 2 (relais)"
            default 26

        config ARROSAGE_VALVE3_GPIO
            int "GPIO vanne 3 (relais)"
            default 27

        config ARROSAGE_WATER_LEVEL_TRIG_GPIO
            int "GPIO trig capteur ultrason (niveau d'eau)"
            default 32

        config ARROSAGE_WATER_LEVEL_ECHO_GPIO
            int "GPIO echo capteur ultrason (niveau d'eau)"
            default 33

        config ARROSAGE_TEMPERATURE_GPIO
            int "GPIO sonde DS18B20 (1-Wire, temperature)"
            default 4

        config ARROSAGE_SOIL_HUMIDITY_ADC_CHANNEL
            int "Canal ADC1 capteur d'humidite du sol (capacitif)"
            range 0 9
            default 6
            help
                Canal ADC1 (pas le numero de GPIO). Sur ESP32 classique, le
                canal 6 correspond a GPIO34 - voir la documentation ESP-IDF
                (peripherals/adc) pour la table de correspondance canal/GPIO
                complete si un autre canal est utilise.

    endmenu

    config ARROSAGE_ENABLE_WEB_SERVER
        bool "Activer le serveur web local de test (port 80)"
        default y
        help
            Serveur HTTP local (page de test + API JSON) permettant de lire
            l'etat et d'envoyer des commandes exactement au meme format que
            le contrat MQTT, sans dependre du backend/broker. Utile pour
            valider le firmware avant de brancher le vrai serveur. HTTP
            simple, sans authentification - reseau local de confiance
            uniquement (meme modele que le broker Mosquitto anonyme).

    config ARROSAGE_ENABLE_OTA
        bool "Activer la mise a jour du firmware par WiFi (OTA, POST /api/ota)"
        depends on ARROSAGE_ENABLE_WEB_SERVER
        default y
        help
            Ajoute un endpoint POST /api/ota au serveur web de test,
            permettant d'envoyer un nouveau firmware (.bin) depuis la page
            web ou via curl, sans passer par USB. Active par defaut, au
            meme titre que le reste du serveur web (lecture d'etat,
            pilotage des vannes) - meme modele de confiance ("reseau local
            de confiance uniquement"). A la difference des autres fonctions
            du serveur toutefois, une mise a jour de firmware acceptee sans
            authentification equivaut a une prise de controle totale du
            device par quiconque sur le reseau local : desactiver cette
            option si le reseau n'est pas de confiance.

            Necessite une table de partitions compatible OTA (voir
            sdkconfig.defaults, CONFIG_PARTITION_TABLE_TWO_OTA) : un device
            deja flashe avec l'ancienne table "single app" doit etre
            entierement reflashe une fois (idf.py erase-flash puis idf.py
            flash) avant de pouvoir utiliser cette fonctionnalite.

endmenu
```
